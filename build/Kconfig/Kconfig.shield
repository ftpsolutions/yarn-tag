## build/Kconfig/Kconfig.shield
```kconfig
osource "/Users/acea/Documents/FTP/software/yarn-tag/boards/shields/*/Kconfig.shield"
osource "/opt/nordic/ncs/v2.5.0/nrf/boards/shields/*/Kconfig.shield"
```

## build/Kconfig/Kconfig.shield.defconfig
```kconfig
osource "/Users/acea/Documents/FTP/software/yarn-tag/boards/shields/*/Kconfig.defconfig"
osource "/opt/nordic/ncs/v2.5.0/nrf/boards/shields/*/Kconfig.defconfig"
```
